


// Code written by Srihari Ayapila - email ->  16bec021@smvdu.ac.in

// This program requires a Nokia 5110 LCD module.

//The connections I made were :
//      SCK  - Pin 7
//      MOSI - Pin 6
//      DC   - Pin 5
//      RST  - Pin 3
//      CS   - Pin 4
//


#include <Adafruit_GFX.h>
#include <LCD5110_Graph.h>
#include <avr/pgmspace.h>


LCD5110 lcd(7,6,5,9,4);

const uint8_t chariWidth    = 9;
const uint8_t chariHeight   = 16;
const uint8_t revchariWidth  = 9;
const uint8_t revchariHeight  = 16;
const uint8_t pooriWidth    = 7;
const uint8_t pooriHeight   = 5;

char chariXpos = 0;
char chariYpos = 10;
char pooriXpos = 20;
char pooriYpos = 10;

const uint8_t fwdBtn = 2;
const uint8_t revBtn = 3;


int flag = 0;

const uint8_t PROGMEM chari[] = { 
     0x04, 0x04, 0x06, 0x9e, 0xe5, 0xa3, 0x1e, 0x00, 0x00, 
  0x00, 0xce, 0xe3, 0xfe, 0x06, 0x06, 0xfd, 0xa1, 0xc1
};

const uint8_t PROGMEM revchari[] = { 
  0x00, 0x00, 0x1e, 0xa3, 0xe5, 0x9e, 0x06, 0x04, 0x04, 
  0xc1, 0xa1, 0xfd, 0x06, 0x06, 0xfe, 0xe3, 0xce, 0x00
};
const uint8_t PROGMEM poori[] = { 
  0x0c, 0x1e, 0x12, 0x12, 0x12, 0x1e, 0x0c
};

const uint8_t PROGMEM gameover[] = { 
  0x00, 0x00, 0x00, 0x00, 0x00, 0x00, 0x00, 0x00, 0x00, 0x00, 0x00, 0x00,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 0x00, 
  0x00, 0x00, 0x00, 0x00, 0x00, 0xfc, 0xfc, 0x83, 0x33, 0x33, 0xf3, 0xf0,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 0x00, 
  0x00, 0x00, 0x00, 0x00, 0x00, 0x00, 0x01, 0x01, 0x03, 0x03, 0x01, 0x01,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 0x00, 
  0x00, 0x00, 0x00, 0x00, 0x00, 0x00, 0x00, 0x00, 0x00, 0x00, 0x00, 0x00,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 0x00, 
  0x00, 0x00, 0x00, 0x00, 0x00, 0x00, 0x00, 0x00, 0x00, 0x00, 0x00, 0x00,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 0x00, 
  0x00, 0x00, 0x00, 0x00, 0x00, 0x00, 0x00, 0x00, 0x00, 0x00, 0x00, 0x00,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 0x00
};

void chari_fwd() {

   chariXpos+=1;
   flag = 1;

}

void chari_rev()
{

  chariXpos -=1;
  flag = 0;

}

void setup()
{
  lcd.InitLCD();
  attachInterrupt(0,chari_fwd,RISING);
  attachInterrupt(1,chari_rev,RISING);
}

 
void loop()
{

  while(abs(chariXpos - pooriXpos-1)!= 0)
  {lcd.clrScr();
   lcd.drawBitmap(pooriXpos,pooriYpos,poori,pooriWidth,pooriHeight);
  if(flag ==0)
  {lcd.drawBitmap(chariXpos,chariYpos,revchari,chariWidth,chariHeight);
  }

  if(flag ==1)
  {lcd.drawBitmap(chariXpos,chariYpos,chari,chariWidth,chariHeight);
  }

 
  lcd.update();
  }


lcd.clrScr();
lcd.drawBitmap(0,0,gameover,84,48);
lcd.update();
delay(3000);
chariXpos = 0;                                                     
chariYpos  = 10;
pooriXpos = 20;
pooriYpos = 10;


}


